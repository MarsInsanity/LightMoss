## Config.in
```kconfig
menu "LightMoss"

config BR2_LIGHTMOSS_LIB32
	bool "LightMoss 32-bit (armhf) runtime build"
	depends on BR2_ARM_EABIHF && BR2_TOOLCHAIN_USES_GLIBC
	help
	  Set only in configs/lightmoss_*_lib32_defconfig: this build
	  is not an image but the armhf libraries the 64-bit image carries
	  in /usr/lib/arm-linux-gnueabihf (package lightmoss-lib32). Its
	  glibc's loader searches that directory.

config BR2_LIGHTMOSS_SDL2_VULKAN
	bool
	help
	  SDL2 built with its Vulkan support (external.mk), which
	  buildroot's sdl2 package turns off. Selected by the Vulkan
	  drivers LightMoss carries.

config BR2_LIGHTMOSS_MESA3D_TURNIP
	bool "Mesa Vulkan freedreno driver (Turnip)"
	depends on BR2_PACKAGE_MESA3D_GALLIUM_DRIVER_FREEDRENO
	select BR2_PACKAGE_MESA3D_VULKAN_DRIVER
	select BR2_LIGHTMOSS_SDL2_VULKAN
	help
	  Mesa's Vulkan driver for Adreno GPUs (Turnip,
	  -Dvulkan-drivers=freedreno), which buildroot's mesa3d package
	  has no option for: selecting its hidden Vulkan driver symbol
	  gives mesa3d.mk the glslang host tool and the
	  -Dvulkan-drivers option, and external.mk adds freedreno to
	  it. Set only in configs/lightmoss_rpminiv2*_defconfig. The
	  Khronos loader (BR2_PACKAGE_VULKAN_LOADER) is what programs
	  link.

	source "$BR2_EXTERNAL_LIGHTMOSS_PATH/package/rk3326-mali/Config.in"
	source "$BR2_EXTERNAL_LIGHTMOSS_PATH/package/rk3326-uboot/Config.in"
	source "$BR2_EXTERNAL_LIGHTMOSS_PATH/package/lightmoss-linux510/Config.in"
	source "$BR2_EXTERNAL_LIGHTMOSS_PATH/package/hpjackd/Config.in"
	source "$BR2_EXTERNAL_LIGHTMOSS_PATH/package/lightmoss-lib32/Config.in"
	source "$BR2_EXTERNAL_LIGHTMOSS_PATH/package/sdl3/Config.in"
	source "$BR2_EXTERNAL_LIGHTMOSS_PATH/package/sdl3_image/Config.in"
	source "$BR2_EXTERNAL_LIGHTMOSS_PATH/package/sdl3_mixer/Config.in"
	source "$BR2_EXTERNAL_LIGHTMOSS_PATH/package/sdl3_ttf/Config.in"
	source "$BR2_EXTERNAL_LIGHTMOSS_PATH/package/alsa-ucm-conf/Config.in"
	source "$BR2_EXTERNAL_LIGHTMOSS_PATH/package/lightmoss-firmware-sm8250/Config.in"
	source "$BR2_EXTERNAL_LIGHTMOSS_PATH/package/openabl/Config.in"
	source "$BR2_EXTERNAL_LIGHTMOSS_PATH/package/lightmoss-volkeys/Config.in"
endmenu
```

## package/alsa-ucm-conf/Config.in
```kconfig
config BR2_PACKAGE_ALSA_UCM_CONF
	bool "alsa-ucm-conf"
	depends on BR2_PACKAGE_ALSA_LIB
	select BR2_PACKAGE_ALSA_LIB_UCM
	help
	  ALSA's Use Case Manager configurations (/usr/share/alsa/ucm2),
	  with ROCKNIX's Retroid Pocket SM8250 sound card configuration:
	  how the codecs are switched on for the speakers, the headphones
	  and the headset microphone.

	  https://github.com/alsa-project/alsa-ucm-conf

comment "alsa-ucm-conf needs alsa-lib"
	depends on !BR2_PACKAGE_ALSA_LIB
```

## package/lightmoss-firmware-sm8250/Config.in
```kconfig
config BR2_PACKAGE_LIGHTMOSS_FIRMWARE_SM8250
	bool "lightmoss-firmware-sm8250"
	depends on BR2_aarch64
	help
	  The SM8250 firmware the Retroid Pocket Mini V2 needs, the
	  files ROCKNIX installs for its SM8250 devices
	  (projects/ROCKNIX/devices/SM8250/config/kernel-firmware.dat):
	  Adreno 650 (GMU, SQE, zap shader), the audio, compute and
	  sensor DSPs, the video decoder, QCA6390 Wi-Fi (ath11k) and
	  Bluetooth. From linux-firmware, in /usr/lib/firmware.
```

## package/lightmoss-linux510/Config.in
```kconfig
config BR2_PACKAGE_LIGHTMOSS_LINUX510
	bool "lightmoss-linux510 (R36S second kernel, BSP 5.10)"
	depends on BR2_aarch64
	depends on BR2_LINUX_KERNEL
	help
	  Rockchip's BSP 5.10 kernel (jokubasver/rockchip-kernel,
	  arkos4clone-5.10) built next to the 4.4 kernel, for the
	  R36S clone: Image-5.10, its DTBs for both panels and its
	  modules in /lib/modules. boot.ini starts it instead of 4.4
	  when "lightmoss-kernel-5.10" is on the BOOT partition. It
	  runs the Mali g29p1 blob (rk3326-mali-g29p1), with Vulkan.

	  Set only in configs/lightmoss_r36s_defconfig.
```

## package/lightmoss-volkeys/Config.in
```kconfig
config BR2_PACKAGE_LIGHTMOSS_VOLKEYS
	bool "lightmoss-volkeys"
	help
	  One input device ("LightMoss Volume Keys", through uinput)
	  for a volume rocker whose two keys come from two devices, as
	  on the Retroid Pocket Mini V2 (gpio-keys and the PMIC's resin
	  key): spruce watches the volume keys on a single node.
```

## package/openabl/Config.in
```kconfig
config BR2_PACKAGE_OPENABL
	bool "openabl"
	depends on BR2_aarch64
	help
	  OpenABL, the Open Handheld Collective's build of Qualcomm's
	  Android bootloader (ABL) with a boot menu and standard Linux
	  boot (Boot Loader Specification entries on FAT partitions),
	  for the SM8250. Nothing goes in the root filesystem: the
	  signed image (abl_signed-SM8250.elf) goes to
	  $(BINARIES_DIR)/openabl, from where post-image puts it on the
	  card's boot partition, for installing.

	  https://github.com/OpenHandheldCollective/OpenABL
```

## package/rk3326-mali/Config.in
```kconfig
config BR2_PACKAGE_RK3326_MALI
	bool "rk3326-mali"
	depends on BR2_aarch64 || BR2_ARM_EABIHF
	depends on BR2_INSTALL_LIBSTDCPP
	depends on BR2_TOOLCHAIN_USES_GLIBC
	depends on BR2_TOOLCHAIN_HAS_THREADS
	select BR2_PACKAGE_HAS_LIBEGL
	select BR2_PACKAGE_HAS_LIBGLES
	select BR2_PACKAGE_HAS_LIBGBM
	select BR2_PACKAGE_LIBGBM_HAS_FEATURE_DMA_BUF
	select BR2_PACKAGE_LIBDRM
	help
	  The Mali-G31 (Bifrost) user-space blob for the RK3326 on the
	  rg351 4.4 kernel, 64-bit or 32-bit (armhf): libmali-bifrost-g31-rxp0-gbm.so from
	  christianhaitian/rk3326_core_builds, the build that matches
	  that kernel's r12p0 kbase driver (rockchip's newer libmali
	  does not). Provides EGL, GLES 1/2/3 and GBM; the headers are
	  rockchip's libmali ones.

	  Unlike buildroot's rockchip-mali, this does not build an
	  out-of-tree kbase module: the kernel has its own.

if BR2_PACKAGE_RK3326_MALI

config BR2_PACKAGE_RK3326_MALI_G29P1
	bool "also the g29p1 blob, for a BSP 5.10 kernel"
	select BR2_LIGHTMOSS_SDL2_VULKAN if BR2_aarch64
	select BR2_PACKAGE_VULKAN_LOADER if BR2_aarch64
	help
	  Installs rockchip's g29p1 blob (libmali-next, with Vulkan
	  1.3) in /usr/lib/mali-g29p1, for the R36S's second kernel
	  (lightmoss-linux510), whose kbase it matches. In the 64-bit
	  image, lightmoss-mali-select bind-mounts it over the rxp0
	  blob when a 5.10 kernel runs and gives the Vulkan loader its
	  manifest; under 4.4 nothing changes. Set it in both the
	  image's and the lib32 build's R36S defconfigs.

config BR2_PACKAGE_PROVIDES_LIBEGL
	default "rk3326-mali"

config BR2_PACKAGE_PROVIDES_LIBGLES
	default "rk3326-mali"

config BR2_PACKAGE_PROVIDES_LIBGBM
	default "rk3326-mali"

endif

comment "rk3326-mali needs an aarch64 or armhf glibc toolchain w/ C++, threads"
	depends on BR2_aarch64 || BR2_ARM_EABIHF
	depends on !BR2_INSTALL_LIBSTDCPP || !BR2_TOOLCHAIN_USES_GLIBC || \
		!BR2_TOOLCHAIN_HAS_THREADS
```
