## Config.in
```kconfig
menu "LightMoss"

config BR2_LIGHTMOSS_LIB32
	bool "LightMoss 32-bit (armhf) runtime build"
	depends on BR2_ARM_EABIHF && BR2_TOOLCHAIN_USES_GLIBC
	help
	  Set only in configs/lightmoss_r36s_lib32_defconfig: this build
	  is not an image but the armhf libraries the 64-bit image carries
	  in /usr/lib/arm-linux-gnueabihf (package lightmoss-lib32). Its
	  glibc's loader searches that directory.

	source "$BR2_EXTERNAL_LIGHTMOSS_PATH/package/rk3326-mali/Config.in"
	source "$BR2_EXTERNAL_LIGHTMOSS_PATH/package/rk3326-uboot/Config.in"
	source "$BR2_EXTERNAL_LIGHTMOSS_PATH/package/hpjackd/Config.in"
	source "$BR2_EXTERNAL_LIGHTMOSS_PATH/package/lightmoss-lib32/Config.in"
	source "$BR2_EXTERNAL_LIGHTMOSS_PATH/package/sdl3/Config.in"
	source "$BR2_EXTERNAL_LIGHTMOSS_PATH/package/sdl3_image/Config.in"
	source "$BR2_EXTERNAL_LIGHTMOSS_PATH/package/sdl3_mixer/Config.in"
	source "$BR2_EXTERNAL_LIGHTMOSS_PATH/package/sdl3_ttf/Config.in"
endmenu
```

## package/hpjackd/Config.in
```kconfig
config BR2_PACKAGE_HPJACKD
	bool "hpjackd"
	depends on BR2_PACKAGE_ALSA_LIB
	help
	  Moves the rk817 codec's "Playback Path" to HP while
	  headphones are plugged in and back to SPK when they come
	  out, following the sound card's jack switch. Honours
	  /boot/headphones-invert for boards that report the jack the
	  other way round.

comment "hpjackd needs alsa-lib"
	depends on !BR2_PACKAGE_ALSA_LIB
```

## package/lightmoss-lib32/Config.in
```kconfig
config BR2_PACKAGE_LIGHTMOSS_LIB32
	bool "lightmoss-lib32"
	depends on BR2_aarch64
	help
	  The 32-bit (armhf) runtime: glibc, libstdc++, SDL2 and its
	  companions, OpenAL, ALSA, the armhf Mali blob and the codec
	  libraries, built by configs/lightmoss_r36s_lib32_defconfig and
	  installed in /usr/lib/arm-linux-gnueabihf with the loader at
	  /lib/ld-linux-armhf.so.3 (Debian's paths). For PortMaster
	  ports and spruce cores that only exist as armhf binaries.

	  The lib32 build must be done first, into LIGHTMOSS_LIB32_DIR
	  (default: this build's output directory with "-lib32"
	  appended); the top-level Makefile does that.
```

## package/rk3326-mali/Config.in
```kconfig
config BR2_PACKAGE_RK3326_MALI
	bool "rk3326-mali"
	depends on BR2_aarch64
	depends on BR2_INSTALL_LIBSTDCPP
	depends on BR2_TOOLCHAIN_USES_GLIBC
	depends on BR2_TOOLCHAIN_HAS_THREADS
	select BR2_PACKAGE_HAS_LIBEGL
	select BR2_PACKAGE_HAS_LIBGLES
	select BR2_PACKAGE_HAS_LIBGBM
	select BR2_PACKAGE_LIBGBM_HAS_FEATURE_DMA_BUF
	select BR2_PACKAGE_LIBDRM
	help
	  The Mali-G31 (Bifrost) user-space blob for the RK3326 on the
	  rg351 4.4 kernel: libmali-bifrost-g31-rxp0-gbm.so from
	  christianhaitian/rk3326_core_builds, the build that matches
	  that kernel's r12p0 kbase driver (rockchip's newer libmali
	  does not). Provides EGL, GLES 1/2/3 and GBM; the headers are
	  rockchip's libmali ones.

	  Unlike buildroot's rockchip-mali, this does not build an
	  out-of-tree kbase module: the kernel has its own.

if BR2_PACKAGE_RK3326_MALI

config BR2_PACKAGE_PROVIDES_LIBEGL
	default "rk3326-mali"

config BR2_PACKAGE_PROVIDES_LIBGLES
	default "rk3326-mali"

config BR2_PACKAGE_PROVIDES_LIBGBM
	default "rk3326-mali"

endif

comment "rk3326-mali needs an aarch64 glibc toolchain w/ C++, threads"
	depends on BR2_aarch64
	depends on !BR2_INSTALL_LIBSTDCPP || !BR2_TOOLCHAIN_USES_GLIBC || \
		!BR2_TOOLCHAIN_HAS_THREADS
```

## package/rk3326-uboot/Config.in
```kconfig
config BR2_PACKAGE_RK3326_UBOOT
	bool "rk3326-uboot (R36S clone, G80CA)"
	depends on BR2_aarch64
	depends on BR2_HOSTARCH = "x86_64" # Linaro GCC 6.3 binaries
	help
	  Rockchip's legacy U-Boot (2017.09) as christianhaitian's
	  RG351MP-u-boot builds it for the RK3326 handhelds, with the
	  R36S clone's G80CA board and both of its panels (from
	  BobMoss), the panel-ID check, and LightMoss's fallback to the
	  internal eMMC when TF1 holds no system.

	  Produces idbloader.img, uboot.img and trust.img for the raw
	  boot sectors, and uboot.dtb / uboot-panel9.dtb for BOOT.
```

## package/sdl3/Config.in
```kconfig
config BR2_PACKAGE_SDL3
	bool "sdl3"
	depends on BR2_TOOLCHAIN_HAS_THREADS # libdrm
	depends on !BR2_STATIC_LIBS
	depends on BR2_PACKAGE_HAS_LIBGBM
	depends on BR2_PACKAGE_HAS_LIBEGL
	depends on BR2_PACKAGE_HAS_LIBGLES
	select BR2_PACKAGE_LIBDRM
	help
	  Simple DirectMedia Layer 3, built the way SDL2 is here: the
	  KMS/DRM video driver with OpenGL ES over the GBM/EGL provider
	  (the Mali blob), ALSA audio, udev input hotplug. No X11,
	  Wayland, Vulkan, PulseAudio, PipeWire or D-Bus.

	  For PortMaster ports that link libSDL3.so.0 (dArkMoss and
	  ArkOS carry it since spruceUI/dArkMoss e598bfa).

	  https://www.libsdl.org/

comment "sdl3 needs a GBM, EGL and OpenGL ES provider and a toolchain w/ threads, dynamic library"
	depends on !BR2_PACKAGE_HAS_LIBGBM || !BR2_PACKAGE_HAS_LIBEGL || \
		!BR2_PACKAGE_HAS_LIBGLES || !BR2_TOOLCHAIN_HAS_THREADS || \
		BR2_STATIC_LIBS
```

## package/sdl3_image/Config.in
```kconfig
config BR2_PACKAGE_SDL3_IMAGE
	bool "sdl3_image"
	depends on BR2_PACKAGE_SDL3
	help
	  SDL3_image: image loading for SDL3. BMP, GIF, JPEG (stb_image),
	  PNG (libpng when enabled), SVG, QOI, TGA and the other built-in
	  formats; TIFF and WebP when those libraries are enabled.

	  https://github.com/libsdl-org/SDL_image
```

## package/sdl3_mixer/Config.in
```kconfig
config BR2_PACKAGE_SDL3_MIXER
	bool "sdl3_mixer"
	depends on BR2_PACKAGE_SDL3
	help
	  SDL3_mixer: audio mixing for SDL3. WAV, AIFF, VOC, AU, FLAC,
	  MP3, Ogg Vorbis and MIDI (Timidity) built in; libFLAC,
	  libvorbisfile, mpg123, opusfile and WavPack when enabled.

	  https://github.com/libsdl-org/SDL_mixer
```

## package/sdl3_ttf/Config.in
```kconfig
config BR2_PACKAGE_SDL3_TTF
	bool "sdl3_ttf"
	depends on BR2_PACKAGE_SDL3
	select BR2_PACKAGE_FREETYPE
	help
	  SDL3_ttf: TrueType fonts for SDL3, over FreeType (HarfBuzz
	  shaping when HarfBuzz is enabled).

	  https://github.com/libsdl-org/SDL_ttf
```
